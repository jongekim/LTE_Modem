## boards/arm/nrf52832/Kconfig.defconfig
```kconfig
# Copyright (c) 2024 Nordic Semiconductor ASA
# SPDX-License-Identifier: Apache-2.0

if BOARD_NRF52832

config BOARD
	default "nrf52832"

config BT_CTLR
   default BT


endif
```

## build/Kconfig/Kconfig.shield
```kconfig
osource "/Users/jongeunkim/Desktop/modem_dev/boards/shields/*/Kconfig.shield"
osource "/opt/nordic/ncs/v2.6.99/nrf/boards/shields/*/Kconfig.shield"
```

## build/Kconfig/Kconfig.shield.defconfig
```kconfig
osource "/Users/jongeunkim/Desktop/modem_dev/boards/shields/*/Kconfig.defconfig"
osource "/opt/nordic/ncs/v2.6.99/nrf/boards/shields/*/Kconfig.defconfig"
```

## build/Kconfig/Kconfig.sysbuild.modules
```kconfig
menu "nrf (/opt/nordic/ncs/v2.6.99/nrf)"
osource "/opt/nordic/ncs/v2.6.99/nrf/sysbuild/Kconfig.sysbuild"
config ZEPHYR_NRF_MODULE
	bool
	default y
endmenu
```
